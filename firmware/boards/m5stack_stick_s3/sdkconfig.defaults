## firmware/boards/m5stack_stick_s3/sdkconfig.defaults
```kconfig
CONFIG_IDF_TARGET="esp32s3"
CONFIG_ESPTOOLPY_FLASHMODE_QIO=y
CONFIG_SPIRAM=y
CONFIG_SPIRAM_MODE_OCT=y
CONFIG_SPIRAM_SPEED_80M=y
CONFIG_SPIRAM_USE_MALLOC=y
CONFIG_LV_BUILD_EXAMPLES=n
CONFIG_LV_FONT_MONTSERRAT_10=y
CONFIG_LV_FONT_MONTSERRAT_12=y
CONFIG_LV_FONT_MONTSERRAT_14=y
CONFIG_LV_FONT_MONTSERRAT_16=y
CONFIG_LV_FONT_DEFAULT_MONTSERRAT_14=y
# No 32 kHz crystal: the main crystal clocks BLE modem sleep.
CONFIG_BT_CTRL_MAIN_XTAL_PU_DURING_LIGHT_SLEEP=y
```

## firmware/boards/magiclick_2p5/sdkconfig.defaults
```kconfig
CONFIG_IDF_TARGET="esp32s3"
CONFIG_ESPTOOLPY_FLASHSIZE_16MB=y
CONFIG_ESPTOOLPY_FLASHMODE_DIO=y
CONFIG_SPIRAM=y
CONFIG_SPIRAM_MODE_OCT=y
CONFIG_SPIRAM_SPEED_80M=y
CONFIG_SPIRAM_USE_MALLOC=y
CONFIG_LV_BUILD_EXAMPLES=n
CONFIG_LV_FONT_MONTSERRAT_10=y
CONFIG_LV_FONT_MONTSERRAT_12=y
CONFIG_LV_FONT_MONTSERRAT_14=y
CONFIG_LV_FONT_MONTSERRAT_16=y
CONFIG_LV_FONT_DEFAULT_MONTSERRAT_14=y
CONFIG_BT_CTRL_MAIN_XTAL_PU_DURING_LIGHT_SLEEP=y
CONFIG_USJ_NO_AUTO_LS_ON_CONNECTION=y
CONFIG_VOICE_STICK_BLE_BATTERY_STATUS=y
```

## firmware/boards/voicestick_c3/components/board/Kconfig
```kconfig
menu "VoiceStick C3 microphone"

    choice VOICE_STICK_PDM_CLOCK
        prompt "PDM clock"
        default VOICE_STICK_PDM_CLOCK_1536K
        help
            The SD18OB371 only accepts clocks inside 1.38-1.7, 2.1-2.6 or
            2.9-4.8 MHz. The decimation ratio follows from the 16 kHz output.

        config VOICE_STICK_PDM_CLOCK_1536K
            bool "1.536 MHz (decimation 96)"
        config VOICE_STICK_PDM_CLOCK_3072K
            bool "3.072 MHz (decimation 192, about twice the CPU and DMA RAM)"
    endchoice

    config VOICE_STICK_PDM_DECIMATION
        int
        default 96 if VOICE_STICK_PDM_CLOCK_1536K
        default 192 if VOICE_STICK_PDM_CLOCK_3072K

    config VOICE_STICK_PDM_RIGHT_SLOT
        bool "Take the right I2S slot"
        default n
        help
            The mic's L/R pin is tied low, which is the left slot. Only for
            bring-up if the left slot turns out silent.

    config VOICE_STICK_PDM_INVERT_CLK
        bool "Invert the PDM clock"
        default n

    config VOICE_STICK_PDM_CAPTURE
        bool "Raw PDM capture on the prev key (bring-up)"
        default n
        help
            While the prev key is held, record the raw bitstream and print it
            as base64 between "PDMRAW BEGIN" and "PDMRAW END" on the console.

    config VOICE_STICK_MIC_GAIN
        int "Digital gain after decimation (x)"
        range 1 64
        default 32
        help
            -37 dBFS sensitivity puts speech near -55 dBFS; x32 is +30 dB,
            which clips at about 101 dB SPL.

endmenu
```

## firmware/components/audio_pipeline/Kconfig
```kconfig
menu "Voice Stick audio"

    config VOICE_STICK_OPUS_COMPLEXITY
        int "Opus encoder complexity"
        range 0 10
        default 1
        help
            Higher values cost more CPU for slightly better quality at the
            same bitrate. Single-core chips should stay at 0.

endmenu
```

## firmware/main/Kconfig.projbuild
```kconfig
menu "Voice Stick"

    config VOICE_STICK_DEEP_SLEEP_TIMEOUT_S
        int "Idle time on battery before deep sleep (seconds)"
        range 30 86400
        default 300
        help
            Deep sleep drops the BLE connection; the talk button or USB wakes
            the device again.

    config VOICE_STICK_DISCONNECTED_SLEEP_TIMEOUT_S
        int "Idle time on battery without a host before deep sleep (seconds)"
        range 30 86400
        default 60
        help
            Applies while no host is connected, so the device stops advertising
            soon after the computer sleeps or leaves. Values above the deep
            sleep timeout have no effect.

    config VOICE_STICK_BLE_BATTERY_STATUS
        bool "Report battery status over BLE"
        default n

    config VOICE_STICK_BLE_ITVL_MIN_UNITS
        int "Normal BLE min connection interval (1.25 ms units)"
        range 12 3200
        default 12
        help
            Minimum BLE connection interval requested for normal operation in
            1.25 ms units (12 = 15 ms, 36 = 45 ms). Must be >= 12 for Apple
            Accessory Design Guidelines compliance.

    config VOICE_STICK_BLE_ITVL_MAX_UNITS
        int "Normal BLE max connection interval (1.25 ms units)"
        range 24 3200
        default 24
        help
            Maximum BLE connection interval requested for normal operation in
            1.25 ms units (24 = 30 ms, 48 = 60 ms). Should be at least 12 units
            (15 ms) above the minimum interval for Apple compliance.

    config VOICE_STICK_BLE_SLAVE_LATENCY
        int "Normal BLE peripheral latency (skipped connection events)"
        range 0 30
        default 30
        help
            Number of connection events the peripheral may skip when idle.
            Keep interval_max_ms * (latency + 1) <= 2000 ms for Apple compliance.

endmenu
```

## firmware/sdkconfig.defaults
```kconfig
# Shared by every board; boards/<board>/sdkconfig.defaults is applied on top.
CONFIG_ESPTOOLPY_FLASHSIZE_8MB=y
CONFIG_ESPTOOLPY_FLASHSIZE="8MB"
CONFIG_PARTITION_TABLE_CUSTOM=y
CONFIG_PARTITION_TABLE_CUSTOM_FILENAME="partitions_ota.csv"
CONFIG_PARTITION_TABLE_FILENAME="partitions_ota.csv"
CONFIG_BT_ENABLED=y
CONFIG_BT_NIMBLE_ENABLED=y
CONFIG_BT_NIMBLE_ROLE_PERIPHERAL=y
CONFIG_BT_NIMBLE_LOG_LEVEL_WARNING=y
CONFIG_BT_NIMBLE_MAX_CONNECTIONS=1
CONFIG_BT_NIMBLE_NVS_PERSIST=y
CONFIG_BT_NIMBLE_SM_LVL=2
CONFIG_BT_NIMBLE_ATT_PREFERRED_MTU=247
CONFIG_BT_NIMBLE_MSYS_1_BLOCK_COUNT=100
CONFIG_BT_NIMBLE_MSYS_1_BLOCK_SIZE=256
CONFIG_BT_NIMBLE_MSYS_2_BLOCK_COUNT=0
CONFIG_BT_NIMBLE_MSYS_2_BLOCK_SIZE=320
CONFIG_BT_CTRL_MODEM_SLEEP=y
CONFIG_FREERTOS_HZ=1000
CONFIG_PM_ENABLE=y
CONFIG_FREERTOS_USE_TICKLESS_IDLE=y
CONFIG_FREERTOS_IDLE_TIME_BEFORE_SLEEP=3
CONFIG_ESP_CONSOLE_USB_SERIAL_JTAG=y
```
